## arch/arm/configs/msm8226-sec_hl3gds_eur_defconfig
```kconfig
#variant defconfig
CONFIG_MACH_HLITE_EUR_3GDS=y

# CONFIG_MACH_MS01 is not set

#LCD
CONFIG_FB_MSM_MDSS_MAGNA_OCTA_720P_PANEL=y
CONFIG_ESD_ERR_FG_RECOVERY=y
CONFIG_FB_MSM_MDSS=y
CONFIG_FB_MSM_MDSS_WRITEBACK=y
CONFIG_BACKLIGHT_LCD_SUPPORT=y
#CONFIG_MDNIE_LITE_TUNING=y
CONFIG_MDNIE_VIDEO_ENHANCED=y
CONFIG_LCD_CLASS_DEVICE=y
CONFIG_BACKLIGHT_CLASS_DEVICE=y
CONFIG_LCD_CONNECTION_CHECK=y
#CONFIG_BACKLIGHT_GENERIC is not set

#SvcLED
CONFIG_LEDS_AN30259A=y

#TOUCH
CONFIG_TOUCHSCREEN_MMS152=n
CONFIG_TOUCHSCREEN_BCMTCH15XXX=n
CONFIG_KEYBOARD_CYPRESS_TOUCH=n
CONFIG_KEYBOARD_CYPRESS_TOUCH_20055=y
CONFIG_TOUCHSCREEN_ZINITIX_BT531=n
CONFIG_TOUCHSCREEN_FTS=y
CONFIG_GLOVE_TOUCH=y
#CONFIG_INPUT_BOOSTER=y

#E-PEN
CONFIG_INPUT_WACOM=y
CONFIG_EPEN_WACOM_G9PM=y

#VIBARTOR
# CONFIG_QPNP_VIBRATOR is not set
# CONFIG_MSM_VIBRATOR is not set
#CONFIG_VIBETONZ is not set
CONFIG_MOTOR_DRV_DRV2603=y

#HallSensor
CONFIG_SENSORS_HALL=y

#USB
CONFIG_USB_ANDROID_SAMSUNG_COMPOSITE=y
CONFIG_USB_ANDROID_SAMSUNG_MTP=y
CONFIG_USB_DUN_SUPPORT=y
CONFIG_USB_HOST_NOTIFY=y
CONFIG_USB_STORAGE_DETECT=y
CONFIG_USB_PRINTER=y

#MUIC
CONFIG_SM5502_MUIC=y

#SENSORS
CONFIG_INPUT=y
CONFIG_INPUT_GPIO=y
CONFIG_INPUT_POLLDEV=y
CONFIG_SENSORS_CORE=y
CONFIG_SENSOR_USE_SYMLINK=y
CONFIG_SENSORS_INVENSENSE=y
CONFIG_SENSORS_TMD27723=y
CONFIG_SENSORS_AK09911C=y
#CONFIG_INPUT_MPU6500 is not set
# CONFIG_INPUT_MPU6500_SELFTEST is not set
#CONFIG_INPUT_MPU6500_POLLING is not set
# MPL start
CONFIG_SYSFS=y
CONFIG_STAGING=y
CONFIG_INV_MPU_IIO=y
CONFIG_IIO_SW_RING=y
CONFIG_IIO_ST_HWMON=y
CONFIG_IIO=y
CONFIG_IIO_KFIFO_BUF=y
CONFIG_IIO_TRIGGER=y
CONFIG_IIO_BUFFER=y
# MPL end

#CAMERA
CONFIG_S5K4H5YB=y
CONFIG_S5K6B2YX=y


#Battery
#CONFIG_QPNP_SEC_CHARGER is not set
CONFIG_BATTERY_BCL=y
CONFIG_QPNP_BMS=y
CONFIG_BATTERY_SAMSUNG=y
CONFIG_SAMSUNG_LPM_MODE=y
CONFIG_CHARGER_SMB358=y

#WIFI
#no need

#BT
#no need

# Earjack
CONFIG_SAMSUNG_JACK=y

# DO NOT EXT OVP
CONFIG_NOT_USE_EXT_OVP=y

#W1
CONFIG_W1=y
CONFIG_W1_MASTER_GPIO_MSM=y
CONFIG_W1_SLAVE_DS28EL15=y
```

## drivers/sensors/Kconfig
```kconfig
config SENSORS_CORE
         bool "sensors_core"
         depends on I2C

config SENSOR_USE_SYMLINK
         bool "sensors_symlink"
         depends on I2C

config SENSORS_HSCDTD008A
	depends on I2C
	tristate "hscd alps HSCDTD008A"
	default n
	help
	  This option enables hscd alps HSCDTD008A mag driver

config SENSORS_AK09911C
	tristate "AK09911C compass support"
	default n
	depends on I2C
	help
	  If you say yes here you get support for Asahi Kasei's
	  orientation sensor AK09911C.

source "drivers/sensors/optical/Kconfig"
source "drivers/sensors/mpu6500/Kconfig"
source "drivers/sensors/accelerometer_k2dh/Kconfig"
source "drivers/sensors/grip_sensor/Kconfig"
source "drivers/sensors/accelerometer/Kconfig"
source "drivers/sensors/accelerometer_bma250/Kconfig"
source "drivers/sensors/geomagnetic/Kconfig"
```

## drivers/sensors/optical/Kconfig
```kconfig
config PROXIMITY_SENSOR
	tristate "proximity_sensor"
	default n
config SENSORS_CM36653
	depends on I2C && GENERIC_GPIO
	tristate "Capella CM3663 ambient light and proximity sensor"
	default n
	help
	  This option enables proximity & light sensors using CM3663 driver.
config OPTICAL_TAOS_TMD2672X
	tristate "OPTICAL_TAOS_TMD2672X"
	default n
config OPTICAL_TAOS
	tristate "OPTICAL_TAOS_TMD2772S9"
	default n

config SENSORS_CM36651
	depends on I2C && GENERIC_GPIO
	tristate "Capella CM3663 ambient light and proximity sensor"
	default n
	help
	  This option enables proximity & light sensors using CM3663 driver.

config SENSORS_TMD27723
	depends on I2C
	tristate "TMD27723 driver"
	default n
	help
	   This option enables proximity & light sensors using TMD27723 driver.
```
